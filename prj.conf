## CMakeLists.txt
```
cmake_minimum_required(VERSION 3.20.0)

set(BOARD esp32)

find_package(Zephyr REQUIRED HINTS $ENV{ZEPHYR_BASE})
project(crownstone-router-firmware)

FILE(GLOB app_sources src/*.cpp)
FILE(GLOB app_sources_drivers src/drivers/*.cpp)
FILE(GLOB app_sources_drivers_ble src/drivers/ble/*.cpp)
FILE(GLOB app_sources_socket src/socket/*.cpp)

target_sources(app PRIVATE ${app_sources} ${app_sources_drivers} ${app_sources_drivers_ble} ${app_sources_socket})
target_include_directories(app PRIVATE include/)
target_compile_options(app PRIVATE -fno-threadsafe-statics)
```

## prj.conf
```kconfig
# Copyright (c) 2022 Crownstone

# This file contains Kconfig options for the application

### General ###

# Enables C++ support
CONFIG_CPP=y
CONFIG_CPP_MAIN=y

# Increase heap on DRAM region 0 to 51200, originally 49152 were set on DRAM region 1
# we basically move this memory to DRAM region 0
CONFIG_HEAP_MEM_POOL_SIZE=51200
# Lower the heap size on DRAM region 1 from 49152 to 1024
CONFIG_ESP_HEAP_MEM_POOL_REGION_1_SIZE=1024
# Allow 1024 bytes to be allocated on the heap using stdlib malloc (sprintf)
CONFIG_MINIMAL_LIBC_MALLOC_ARENA_SIZE=1024
# Now that DRAM region 1 has more space, set a big enough stack size
CONFIG_MAIN_STACK_SIZE=12288

# Enable logging
CONFIG_LOG=y
# Modules that don't specify a log level will use this info log level
# 0: OFF, 1: ERROR, 2: WARNING, 3: INFO, 4: DEBUG
CONFIG_LOG_DEFAULT_LEVEL=3

# Enable event objects
CONFIG_EVENTS=y

### Networking ###

CONFIG_NETWORKING=y
CONFIG_NET_TCP=y
CONFIG_NET_IPV6=y
CONFIG_NET_IPV4=y
CONFIG_NET_DHCPV4=y
# Ethernet and Wifi
# CONFIG_NET_IF_MAX_IPV4_COUNT=2
# CONFIG_NET_IF_MAX_IPV6_COUNT=2

# Enable the network management API, and receive networking events
CONFIG_NET_MGMT=y
CONFIG_NET_MGMT_EVENT=y
CONFIG_NET_MGMT_EVENT_INFO=y

# Sockets
CONFIG_NET_SOCKETS=y
# Websocket and HTTP
CONFIG_WEBSOCKET_CLIENT=y
CONFIG_HTTP_CLIENT=y

# Enables logging in the networking stack
CONFIG_NET_LOG=y

# Enable Wifi on ESP32
CONFIG_WIFI=y
CONFIG_WIFI_ESP32=y
# Auto reconnect
CONFIG_ESP32_WIFI_STA_RECONNECT=y

# Enable Ethernet
CONFIG_NET_L2_ETHERNET=y
CONFIG_SPI=y
# CONFIG_ETH_W5500=y

# Enable DNS
CONFIG_DNS_RESOLVER=y

### UART ###

CONFIG_SERIAL=y
CONFIG_UART_INTERRUPT_DRIVEN=y
CONFIG_UART_ESP32=y

### GPIO ###

CONFIG_GPIO=y

### BLE ###

CONFIG_BT=y
CONFIG_BT_HCI=y
CONFIG_BT_FILTER_ACCEPT_LIST=y
CONFIG_BT_CENTRAL=y
CONFIG_BT_GATT_CLIENT=y

# Enable BLE on ESP32
CONFIG_BT_ESP32=y
```

## boards/esp32.overlay
```dts
// / {
// 	aliases {
// 		w5500-ethernet = &w5500;
// 	};
// };

// Enable ESP32 Wifi
&wifi {
	status = "okay";
};

// Enable UART connector for RS485
&uart2 {
	status = "okay";
};

// Enable W5500 Ethernet module
// &spi2 {
// 	status = "okay";
// 	w5500: w5500@0 {
// 		compatible = "wiznet,w5500";
// 		reg = <0>;
// 		spi-max-frequency = <10000000>;
// 		reset-gpios = <&gpio0 25 GPIO_ACTIVE_LOW>;
//     int-gpios = <&gpio0 26 GPIO_ACTIVE_LOW>;
// 	};
// };
```

## include/cs_PacketHandling.h
```c
/**
 * Author: Ricardo Steijn
 * Copyright: Crownstone (https://crownstone.rocks)
 * Date: 13 Jan., 2023
 * License: Apache License 2.0
 */

#pragma once

#include "cs_RouterProtocol.h"
#include "cs_ReturnTypes.h"

#include <zephyr/kernel.h>

#include <stdint.h>
#include <stdbool.h>

#define CS_PACKET_BUF_SIZE   250
#define CS_PACKET_QUEUE_SIZE 14
#define CS_PACKET_HANDLERS   7

#define CS_PACKET_UART_START_TOKEN 0x7E
#define CS_PACKET_UART_CRC_SEED	   0xFFFF

#define CS_PACKET_THREAD_PRIORITY   K_PRIO_COOP(7)
#define CS_PACKET_THREAD_STACK_SIZE 4096

typedef void (*cs_packet_transport_cb_t)(void *inst, uint8_t *msg, int msg_len);

enum cs_packet_transport_type : uint8_t {
	CS_DATA_INCOMING,
	CS_DATA_OUTGOING
};

struct cs_packet_buffer {
	uint8_t buf[CS_PACKET_BUF_SIZE];
	uint16_t buf_len;
};

struct cs_packet_data {
	cs_packet_transport_type type;
	cs_router_instance_id dest_id;
	cs_router_instance_id src_id;
	cs_router_result_code result_code;
	cs_packet_buffer msg;
};

struct cs_packet_result {
	cs_router_command_type type;
	uint16_t id;
};

struct cs_packet_handler {
	k_work work_item;
	k_spinlock work_lock;
	cs_router_instance_id id;
	void *target_inst;
	cs_packet_buffer msg;
	cs_packet_result result;
};

class PacketHandler
{
      public:
	cs_ret_code_t init();
	cs_ret_code_t registerHandler(cs_router_instance_id inst_id, void *inst,
				      k_work_handler_t cb);
	cs_ret_code_t unregisterHandler(cs_router_instance_id inst_id);
	cs_packet_handler *getHandler(cs_router_instance_id inst_id);
	cs_ret_code_t handlePacket(cs_packet_data *data);

	/** Packet message queue */
	k_msgq _pkth_msgq;
	/** Message queue buffer */
	char __aligned(8) _msgq_buf[sizeof(cs_packet_data) * CS_PACKET_QUEUE_SIZE];

	/** Packet handler thread structure instance */
	k_thread _pkth_tid;
	/** Mutex to protect the handlers when the registers is updated */
	k_mutex _pkth_mtx;

      private:
	/** Initialized flag */
	bool _initialized = false;

	/** Packet handler register */
	cs_packet_handler _handlers[CS_PACKET_HANDLERS];
	/** Amount of handlers registered */
	int _handler_ctr = 0;
};
```

## include/cs_ReturnTypes.h
```c
/**
 * Author: Ricardo Steijn
 * Copyright: Crownstone (https://crownstone.rocks)
 * Date: 18 Nov., 2022
 * License: Apache License 2.0
 */

#pragma once

typedef int cs_ret_code_t;

#define CS_OK	0
#define CS_FAIL -1

#define CS_ERR_ALREADY_INITIALIZED     0x101
#define CS_ERR_NOT_INITIALIZED	       0x102
#define CS_ERR_DEVICE_NOT_READY	       0x103
#define CS_ERR_INTERFACE_NOT_AVAILABLE 0x104
#define CS_ERR_NOT_SUPPORTED	       0x105
#define CS_ERR_NOT_ENABLED	       0x106
#define CS_ERR_INVALID_PARAM	       0x107
#define CS_ERR_TIMEOUT		       0x108
#define CS_ERR_ABORTED		       0x109

#define CS_ERR_WIFI_CONNECT_REQUEST_FAILED    0x201
#define CS_ERR_WIFI_SCAN_REQUEST_FAILED	      0x202
#define CS_ERR_WIFI_SCAN_RESULT_TIMEOUT	      0x203
#define CS_ERR_WIFI_DISCONNECT_REQUEST_FAILED 0x204
#define CS_ERR_WIFI_NOT_CONNECTED	      0x205

#define CS_ERR_UART_CONFIG_INVALID 0x301
#define CS_ERR_UART_CONFIG_FAILED  0x302
#define CS_ERR_UART_RX_FAILED	   0x303

#define CS_ERR_SOCKET_UNABLE_TO_RESOLVE_HOST	   0x401
#define CS_ERR_SOCKET_CREATION_FAILED		   0x402
#define CS_ERR_SOCKET_INVALID_MODE		   0x403
#define CS_ERR_SOCKET_CA_CERT_REGISTER_FAILED	   0x404
#define CS_ERR_SOCKET_SET_TLS_TAG_LIST_FAILED	   0x405
#define CS_ERR_SOCKET_SET_TLS_HOSTNAME_FAILED	   0x406
#define CS_ERR_SOCKET_CLOSE_FAILED		   0x407
#define CS_ERR_SOCKET_HTTP_REQ_FAILED		   0x408
#define CS_ERR_SOCKET_CONNECT_FAILED		   0x409
#define CS_ERR_SOCKET_WEBSOCKET_GET_IP_INFO_FAILED 0x410
#define CS_ERR_SOCKET_WEBSOCKET_CONNECT_FAILED	   0x411

#define CS_ERR_BLE_CENTRAL_BLUETOOTH_INIT_FAILED 0x501
#define CS_ERR_BLE_CENTRAL_SCAN_START_FAILED	 0x502
#define CS_ERR_BLE_CENTRAL_NOT_CONNECTED	 0x503
#define CS_ERR_BLE_CENTRAL_ALREADY_CONNECTED	 0x504
#define CS_ERR_BLE_CENTRAL_DISCOVERY_FAILED	 0x505
#define CS_ERR_BLE_CENTRAL_INCORRECT_MTU	 0x506
#define CS_ERR_BLE_CENTRAL_WRITE_FAILED		 0x507
#define CS_ERR_BLE_CENTRAL_READ_FAILED		 0x508
#define CS_ERR_BLE_CENTRAL_CONNECTION_FAILED	 0x509

#define CS_ERR_PACKET_HANDLER_NOT_FOUND		 0x601
#define CS_ERR_PACKET_HANDLER_ALREADY_REGISTERED 0x602
#define CS_ERR_PACKET_HANDLER_NOT_READY		 0x603
```

## include/cs_Router.h
```c
/**
 * Author: Ricardo Steijn
 * Copyright: Crownstone (https://crownstone.rocks)
 * Date: 1 Dec., 2022
 * License: Apache License 2.0
 */

#pragma once

#include <zephyr/kernel.h>

#include <stdint.h>

#define CS_PROTOCOL_VERSION	 1
#define CS_UART_PROTOCOL_VERSION 1

/**
 * @brief Frame struct for an UART Crownstone router communication packet.
 * Used for local communication.
 *
 * @param start_token Start token for a message
 * @param length Length of all data beyond this field, including CRC
 * @param protocol_version Uart protocol version
 * @param type Frame type
 * @param payload Payload containing a Crownstone router packet
 * @param crc CRC16 of everything after length
 */
struct cs_router_uart_packet {
	uint8_t start_token;
	uint16_t length;
	uint8_t protocol_version;
	uint8_t type;
	uint8_t *payload;
	uint16_t crc;
} __packed;

/**
 * @brief Crownstone router packet types.
 */
enum cs_router_uart_packet_type : uint8_t {
	CS_PACKET_TYPE_GENERIC,
	/** CS_PACKET_TYPE_GENERIC_ENCRYPTED */
};

/**
 * @brief Frame struct for a generic Crownstone router communication packet.
 * Used for cloud communication.
 *
 * @param protocol_version Protocol version
 * @param type Frame type
 * @param length Length of the payload
 * @param payload Payload containing an other packet
 */
struct cs_router_generic_packet {
	uint8_t protocol_version;
	uint8_t type;
	uint16_t length;
	uint8_t *payload;
} __packed;

/**
 * @brief Generic packet types.
 */
enum cs_router_generic_packet_type : uint8_t {
	CS_PACKET_TYPE_CONTROL,
	CS_PACKET_TYPE_RESULT,
	CS_PACKET_TYPE_DATA
};

/**
 * @brief Frame struct for a control packet.
 *
 * @param command_type Type of the command
 * @param src_id The id of the source device, used to send result packet back
 * @param dest_id The id of the destination device that should receive this command
 * @param length Length of the payload
 * @param payload Payload according to the command type, depends on length
 */
struct cs_router_control_packet {
	uint8_t command_type;
	uint8_t src_id;
	uint8_t dest_id;
	uint16_t length;
	uint8_t *payload;
} __packed;

/**
 * @brief Frame struct for a result packet.
 *
 * @param command_type Type of the command of which this packet is the result
 * @param result_code The result code
 * @param length Length of the payload
 * @param payload Payload according to the command type, depends on length
 */
struct cs_router_result_packet {
	uint8_t command_type;
	uint8_t result_code;
	uint16_t length;
	uint8_t *payload;
} __packed;

/**
 * @brief Frame struct for a data packet.
 *
 * @param source_id The id of the source where the data comes from
 * @param length Length of the data
 * @param payload Payload according to the data type, depends on length
 */
struct cs_router_data_packet {
	uint8_t source_id;
	uint16_t length;
	uint8_t *payload;
} __packed;

/**
 * @brief Control & result packet command types.
 */
enum cs_router_command_type : uint8_t {
	CS_COMMAND_TYPE_SET_CONFIG,
	CS_COMMAND_TYPE_GET_CONFIG,
	CS_COMMAND_TYPE_WIFI_CONNECT,
	CS_COMMAND_TYPE_WIFI_DISCONNECT,
	CS_COMMAND_TYPE_RESET,
	CS_COMMAND_TYPE_FACTORY_RESET,
	CS_COMMAND_TYPE_SWITCH
};

/**
 * @brief Result packet result types.
 */
enum cs_router_result_code : uint8_t {
	CS_RESULT_TYPE_SUCCES,
	CS_RESULT_TYPE_WAIT_FOR_SUCCESS,
	CS_RESULT_TYPE_SUCCESS_NO_CHANGE,
	CS_RESULT_TYPE_BUFFER_TOO_SMALL = (1 << 3),
	CS_RESULT_TYPE_WRONG_PAYLOAD_LENGTH = (1 << 4),
	CS_RESULT_TYPE_UNKNOWN_TYPE,
	CS_RESULT_TYPE_TIMEOUT,
	CS_RESULT_TYPE_CANCELED,
	CS_RESULT_TYPE_PROTOCOL_UNSUPPORTED,
	CS_RESULT_TYPE_MISMATCH,
	CS_RESUKT_TYPE_NOT_IMPLEMENTED = (1 << 5),
	CS_RESULT_TYPE_NOT_INITIALIZED,
	CS_RESULT_TYPE_READ_FAILED,
	CS_RESULT_TYPE_EVENT_UNHANDLED,
	CS_RESULT_TYPE_UNSPECIFIED = (1 << 7)
};

/**
 * @brief Instance ids.
 */
enum cs_router_instance_id : uint8_t {
	CS_INSTANCE_ID_ESP32, // the controller where this firmware runs, for configuration commands
	CS_INSTANCE_ID_UART_RS485, // e.g. solar panel / heatpump / charging station
	CS_INSTANCE_ID_UART_RS232, // e.g. dutch smart meter
	CS_INSTANCE_ID_UART_CM4,   // raspberry pi computer module 4 where application code runs
	CS_INSTANCE_ID_CLOUD,	   // cloud server where application code runs
	CS_INSTANCE_ID_BLE_CROWNSTONE_MESH,   // crownstone's BLE mesh
	CS_INSTANCE_ID_BLE_CROWNSTONE_CLIENT, // 1 to 1 BLE connection to a crownstone
	CS_INSTANCE_ID_AMOUNT		      // amount of instance id's available
};

/**
 * @brief Frame struct for a set config packet.
 *
 * @param config_type Type of configuration
 * @param config_id Identifier for the configuration to set
 * @param persistence_mode Type of persistence mode
 * @param payload Payload according to the config type
 * @param reserved Reserved for future use
 */
struct cs_router_set_config_packet {
	uint8_t config_type;
	uint8_t config_id;
	uint8_t persistence_mode;
	uint8_t *payload;
	uint8_t reserved;
} __packed;

/**
 * @brief Frame struct for a get config packet.
 *
 * @param config_type Type of configuration
 * @param config_id Identifier for the configuration to get
 * @param persistence_mode Type of persistence mode
 * @param reserved Reserved for future use
 */
struct cs_router_get_config_packet {
	uint8_t config_type;
	uint8_t config_id;
	uint8_t persistence_mode;
	uint8_t reserved;
} __packed;

/**
 * @brief Frame struct for a set config result packet.
 *
 * @param config_type Type of configuration that was set
 * @param config_id Identifier for the configuration that was set
 * @param persistence_mode Type of persistence mode used
 * @param reserved Reserved for future use
 */
struct cs_router_set_config_result_packet {
	uint8_t config_type;
	uint8_t config_id;
	uint8_t persistence_mode;
	uint8_t reserved;
} __packed;

/**
 * @brief Frame struct for a get config result packet.
 *
 * @param config_type Type of configuration that was requested
 * @param config_id Identifier for the configuration that was requested
 * @param persistence_mode Type of persistence mode requested
 * @param payload Payload according to the config type, containing the state
 * @param reserved Reserved for future use
 */
struct cs_router_get_config_result_packet {
	uint8_t config_type;
	uint8_t config_id;
	uint8_t persistence_mode;
	uint8_t *payload;
	uint8_t reserved;
} __packed;

/**
 * @brief Set config packet configuration types.
 */
enum cs_router_config_type : uint8_t {
	CS_CONFIG_TYPE_WIFI_SSID,     // max 32 bytes
	CS_CONFIG_TYPE_WIFI_PSK,      // max 64 bytes
	CS_CONFIG_TYPE_UART_BAUDRATE, // uint32
};

/**
 * @brief Set config persistence modes.
 */
enum cs_router_set_config_persistence_mode : uint8_t {
	CS_SET_CONFIG_PERSISTENCE_MODE_TEMPORARY,
	CS_SET_CONFIG_PERSISTENCE_MODE_STORED
};

/**
 * @brief Get config persistence modes.
 */
enum cs_router_get_config_persistence_mode : uint8_t {
	CS_GET_CONFIG_PERSISTENCE_MODE_CURRENT,
	CS_GET_CONFIG_PERSISTENCE_MODE_STORED,
	CS_GET_CONFIG_PERSISTENCE_MODE_FIRMWARE_DEFAULT
};

/**
 * @brief Frame struct for a switch command packet.
 *
 * @param switch_value Value from 0 to 100, can be analog to support dimming.
 * when using digital, 0 means off and 100 means on.
 */
struct cs_router_switch_command_packet {
	uint8_t switch_value;
} __packed;
```

## include/cs_RouterProtocol.h
```c
/**
 * Author: Ricardo Steijn
 * Copyright: Crownstone (https://crownstone.rocks)
 * Date: 1 Dec., 2022
 * License: Apache License 2.0
 */

#pragma once

#include <zephyr/kernel.h>

#include <stdint.h>

#define CS_PROTOCOL_VERSION	 1
#define CS_UART_PROTOCOL_VERSION 1

/**
 * @brief Frame struct for an UART Crownstone router communication packet.
 * Used for local communication.
 *
 * @param start_token Start token for a message
 * @param length Length of all data beyond this field, including CRC
 * @param protocol_version Uart protocol version
 * @param type Frame type
 * @param payload Payload containing a Crownstone router packet
 * @param crc CRC16 of everything after length
 */
struct cs_router_uart_packet {
	uint8_t start_token;
	uint16_t length;
	uint8_t protocol_version;
	uint8_t type;
	uint8_t *payload;
	uint16_t crc;
} __packed;

/**
 * @brief Crownstone router packet types.
 */
enum cs_router_uart_packet_type : uint8_t {
	CS_PACKET_TYPE_GENERIC,
	/** CS_PACKET_TYPE_GENERIC_ENCRYPTED */
};

/**
 * @brief Frame struct for a generic Crownstone router communication packet.
 * Used for cloud communication.
 *
 * @param protocol_version Protocol version
 * @param type Frame type
 * @param length Length of the payload
 * @param payload Payload containing an other packet
 */
struct cs_router_generic_packet {
	uint8_t protocol_version;
	uint8_t type;
	uint16_t length;
	uint8_t *payload;
} __packed;

/**
 * @brief Generic packet types.
 */
enum cs_router_generic_packet_type : uint8_t {
	CS_PACKET_TYPE_CONTROL,
	CS_PACKET_TYPE_RESULT,
	CS_PACKET_TYPE_DATA
};

/**
 * @brief Frame struct for a control packet.
 *
 * @param command_type Type of the command
 * @param src_id The id of the source device, used to send result packet back
 * @param dest_id The id of the destination device that should receive this command
 * @param request_id Request ID of the command, to be included in the result
 * @param length Length of the payload
 * @param payload Payload according to the command type, depends on length
 */
struct cs_router_control_packet {
	uint8_t command_type;
	uint8_t src_id;
	uint8_t dest_id;
	uint16_t request_id;
	uint16_t length;
	uint8_t *payload;
} __packed;

/**
 * @brief Frame struct for a result packet.
 *
 * @param command_type Type of the command of which this packet is the result
 * @param result_code The result code
 * @param result_id Result ID of the command, so the correct result can be awaited
 * @param length Length of the payload
 * @param payload Payload according to the command type, depends on length
 */
struct cs_router_result_packet {
	uint8_t command_type;
	uint8_t result_code;
	uint16_t request_id;
	uint16_t length;
	uint8_t *payload;
} __packed;

/**
 * @brief Frame struct for a data packet.
 *
 * @param source_id The id of the source where the data comes from
 * @param length Length of the data
 * @param payload Payload according to the data type, depends on length
 */
struct cs_router_data_packet {
	uint8_t source_id;
	uint16_t length;
	uint8_t *payload;
} __packed;

/**
 * @brief Control & result packet command types.
 */
enum cs_router_command_type : uint8_t {
	CS_COMMAND_TYPE_SET_CONFIG,
	CS_COMMAND_TYPE_GET_CONFIG,
	CS_COMMAND_TYPE_WIFI_CONNECT,
	CS_COMMAND_TYPE_WIFI_DISCONNECT,
	CS_COMMAND_TYPE_RESET,
	CS_COMMAND_TYPE_FACTORY_RESET,
	CS_COMMAND_TYPE_SWITCH,
	CS_COMMAND_TYPE_REQUEST
};

/**
 * @brief Result packet result types.
 */
enum cs_router_result_code : uint8_t {
	CS_RESULT_TYPE_SUCCES,
	CS_RESULT_TYPE_WAIT_FOR_SUCCESS,
	CS_RESULT_TYPE_SUCCESS_NO_CHANGE,
	CS_RESULT_TYPE_BUFFER_TOO_SMALL = (1 << 3),
	CS_RESULT_TYPE_WRONG_PAYLOAD_LENGTH = (1 << 4),
	CS_RESULT_TYPE_UNKNOWN_TYPE,
	CS_RESULT_TYPE_TIMEOUT,
	CS_RESULT_TYPE_CANCELED,
	CS_RESULT_TYPE_PROTOCOL_UNSUPPORTED,
	CS_RESULT_TYPE_MISMATCH,
	CS_RESUKT_TYPE_NOT_IMPLEMENTED = (1 << 5),
	CS_RESULT_TYPE_NOT_INITIALIZED,
	CS_RESULT_TYPE_READ_FAILED,
	CS_RESULT_TYPE_EVENT_UNHANDLED,
	CS_RESULT_TYPE_UNSPECIFIED = (1 << 7)
};

/**
 * @brief Instance ids.
 */
enum cs_router_instance_id : uint8_t {
	CS_INSTANCE_ID_UNKNOWN,
	CS_INSTANCE_ID_ESP32,	   // the controller where this firmware runs
	CS_INSTANCE_ID_UART_RS485, // e.g. solar panel / heatpump / charging station
	CS_INSTANCE_ID_UART_RS232, // e.g. dutch smart meter
	CS_INSTANCE_ID_UART_CM4,   // raspberry pi computer module 4 where application code runs
	CS_INSTANCE_ID_CLOUD,	   // cloud server where application code runs
	CS_INSTANCE_ID_BLE_CROWNSTONE_MESH,	  // crownstone's BLE mesh
	CS_INSTANCE_ID_BLE_CROWNSTONE_PERIPHERAL, // Central to peripheral BLE connection
};

/**
 * @brief Frame struct for a set config packet.
 *
 * @param config_type Type of configuration
 * @param config_id Identifier for the configuration to set
 * @param persistence_mode Type of persistence mode
 * @param payload Payload according to the config type
 * @param reserved Reserved for future use
 */
struct cs_router_set_config_packet {
	uint8_t config_type;
	uint8_t config_id;
	uint8_t persistence_mode;
	uint8_t *payload;
	uint8_t reserved;
} __packed;

/**
 * @brief Frame struct for a get config packet.
 *
 * @param config_type Type of configuration
 * @param config_id Identifier for the configuration to get
 * @param persistence_mode Type of persistence mode
 * @param reserved Reserved for future use
 */
struct cs_router_get_config_packet {
	uint8_t config_type;
	uint8_t config_id;
	uint8_t persistence_mode;
	uint8_t reserved;
} __packed;

/**
 * @brief Frame struct for a set config result packet.
 *
 * @param config_type Type of configuration that was set
 * @param config_id Identifier for the configuration that was set
 * @param persistence_mode Type of persistence mode used
 * @param reserved Reserved for future use
 */
struct cs_router_set_config_result_packet {
	uint8_t config_type;
	uint8_t config_id;
	uint8_t persistence_mode;
	uint8_t reserved;
} __packed;

/**
 * @brief Frame struct for a get config result packet.
 *
 * @param config_type Type of configuration that was requested
 * @param config_id Identifier for the configuration that was requested
 * @param persistence_mode Type of persistence mode requested
 * @param payload Payload according to the config type, containing the state
 * @param reserved Reserved for future use
 */
struct cs_router_get_config_result_packet {
	uint8_t config_type;
	uint8_t config_id;
	uint8_t persistence_mode;
	uint8_t *payload;
	uint8_t reserved;
} __packed;

/**
 * @brief Set config packet configuration types.
 */
enum cs_router_config_type : uint8_t {
	CS_CONFIG_TYPE_WIFI_SSID,     // max 32 bytes
	CS_CONFIG_TYPE_WIFI_PSK,      // max 64 bytes
	CS_CONFIG_TYPE_UART_BAUDRATE, // uint32
};

/**
 * @brief Set config persistence modes.
 */
enum cs_router_set_config_persistence_mode : uint8_t {
	CS_SET_CONFIG_PERSISTENCE_MODE_TEMPORARY,
	CS_SET_CONFIG_PERSISTENCE_MODE_STORED
};

/**
 * @brief Get config persistence modes.
 */
enum cs_router_get_config_persistence_mode : uint8_t {
	CS_GET_CONFIG_PERSISTENCE_MODE_CURRENT,
	CS_GET_CONFIG_PERSISTENCE_MODE_STORED,
	CS_GET_CONFIG_PERSISTENCE_MODE_FIRMWARE_DEFAULT
};
```

## src/cs_PacketHanding.cpp
```c
/**
 * Author: Ricardo Steijn
 * Copyright: Crownstone (https://crownstone.rocks)
 * Date: 13 Jan., 2023
 * License: Apache License 2.0
 */

#include "cs_PacketHandling.h"

#include <zephyr/logging/log.h>
LOG_MODULE_REGISTER(cs_PacketHandling, LOG_LEVEL_INF);

#include <zephyr/sys/byteorder.h>
#include <zephyr/sys/crc.h>

K_THREAD_STACK_DEFINE(pkth_tid_stack_area, CS_PACKET_THREAD_STACK_SIZE);

/**
 * @brief Wrap a payload into an UART packet.
 *
 * @param type One of @ref cs_router_uart_packet_type, type of the payload
 * @param payload Buffer that should be wrapped into an UART packet
 * @param payload_len Length of the buffer in bytes
 * @param pkt_buf Buffer where the packet should be stored
 *
 * @return Length of the UART packet in bytes.
 */
static int wrapUartPacket(uint8_t type, uint8_t *payload, int payload_len, uint8_t *pkt_buf)
{
	int uart_pkt_ctr = 0;
	int uart_pkt_len = (sizeof(cs_router_uart_packet) - sizeof(uint8_t *)) + payload_len;

	pkt_buf[uart_pkt_ctr++] = CS_PACKET_UART_START_TOKEN;
	sys_put_le16(uart_pkt_len - 3, pkt_buf + uart_pkt_ctr);
	uart_pkt_ctr += 2;
	pkt_buf[uart_pkt_ctr++] = CS_UART_PROTOCOL_VERSION;
	pkt_buf[uart_pkt_ctr++] = type;
	memcpy(pkt_buf + uart_pkt_ctr, payload, payload_len);
	uart_pkt_ctr += payload_len;

	// calculate CRC16 CCITT over everything after length (so
	// don't include start token and length)
	uint16_t crc = crc16_ccitt(CS_PACKET_UART_CRC_SEED, pkt_buf + 3, uart_pkt_ctr - 3);
	sys_put_le16(crc, pkt_buf + uart_pkt_ctr);

	return uart_pkt_len;
}

/**
 * @brief Wrap a payload into a generic packet.
 *
 * @param type One of @ref cs_router_generic_packet_type, type of the payload
 * @param payload Buffer that should be wrapped into a generic packet
 * @param payload_len Length of the buffer in bytes
 * @param pkt_buf Buffer where the packet should be stored
 *
 * @return Length of the generic packet in bytes.
 */
static int wrapGenericPacket(uint8_t type, uint8_t *payload, int payload_len, uint8_t *pkt_buf)
{
	pkt_buf[0] = CS_PROTOCOL_VERSION;
	pkt_buf[1] = type;
	sys_put_le16(payload_len, pkt_buf + 2);
	memcpy(pkt_buf + 4, payload, payload_len);

	return (sizeof(cs_router_generic_packet) - sizeof(uint8_t *)) + payload_len;
}

/**
 * @brief Wrap a payload into a data packet.
 *
 * @param src_id One of @ref cs_router_instance_id, identifier of the payload source
 * @param payload Buffer that should be wrapped into a data packet
 * @param payload_len Length of the buffer in bytes
 * @param pkt_buf Buffer where the packet should be stored
 *
 * @return Length of the data packet in bytes.
 */
static int wrapDataPacket(uint8_t src_id, uint8_t *payload, int payload_len, uint8_t *pkt_buf)
{
	pkt_buf[0] = src_id;
	sys_put_le16(payload_len, pkt_buf + 1);
	memcpy(pkt_buf + 3, payload, payload_len);

	return (sizeof(cs_router_data_packet) - sizeof(uint8_t *)) + payload_len;
}

/**
 * @brief Wrap a payload into a result packet.
 */
static int wrapResultPacket(uint8_t command_type, uint8_t result_code, uint16_t request_id,
			    uint8_t *payload, uint16_t payload_len, uint8_t *pkt_buf)
{
	int result_pkt_ctr = 0;

	pkt_buf[result_pkt_ctr++] = command_type;
	pkt_buf[result_pkt_ctr++] = result_code;
	sys_put_le16(request_id, pkt_buf + result_pkt_ctr);
	result_pkt_ctr += 2;
	sys_put_le16(payload_len, pkt_buf + result_pkt_ctr);
	result_pkt_ctr += 2;
	memcpy(pkt_buf + result_pkt_ctr, payload, payload_len);

	return (sizeof(cs_router_result_packet) - sizeof(uint8_t *)) + payload_len;
}

/**
 * @brief Load a UART packet from a buffer.
 *
 * @param pkt Pointer to instance of @ref cs_router_uart_packet, which should be loaded with data
 * @param buffer Buffer with data that should be created into an UART packet
 */
static void loadUartPacket(cs_router_uart_packet *uart_pkt, uint8_t *buffer)
{
	int pkt_ctr = 0;

	uart_pkt->start_token = buffer[pkt_ctr++];
	uart_pkt->length = sys_get_le16(buffer + pkt_ctr);
	pkt_ctr += 2;
	uart_pkt->protocol_version = buffer[pkt_ctr++];
	uart_pkt->type = buffer[pkt_ctr++];

	int payload_len = uart_pkt->length - 4; // minus protocol ver, type and CRC
	uart_pkt->payload = &buffer[pkt_ctr];
	pkt_ctr += payload_len;

	// check CRC CCITT over everything after length, not including CRC (uint16) itself
	uint16_t check_crc = crc16_ccitt(CS_PACKET_UART_CRC_SEED, buffer + 3, uart_pkt->length - 2);
	uint16_t received_crc = sys_get_le16(buffer + pkt_ctr);
	// CRC doesn't match, invalid packet
	if (check_crc != received_crc) {
		LOG_WRN("CRC mismatch on received UART packet. Calculated: %hu, Received: %hu",
			check_crc, received_crc);
	}
}

/**
 * @brief Load a generic packet from a buffer.
 *
 * @param generic_pkt Pointer to instance of @ref cs_router_generic_packet, which should be loaded
 * with data
 * @param buffer Buffer with data that should be created into a generic packet
 */
static void loadGenericPacket(cs_router_generic_packet *generic_pkt, uint8_t *buffer)
{
	int pkt_ctr = 0;

	generic_pkt->protocol_version = buffer[pkt_ctr++];
	generic_pkt->type = buffer[pkt_ctr++];
	generic_pkt->length = sys_get_le16(buffer + pkt_ctr);
	pkt_ctr += 2;
	generic_pkt->payload = &buffer[pkt_ctr];

	if (generic_pkt->protocol_version != CS_PROTOCOL_VERSION) {
		LOG_WRN("Protocol mismatch: firmware protocol: %d, provided protocol: %d",
			CS_PROTOCOL_VERSION, generic_pkt->protocol_version);
	}
}

/**
 * @brief Load a control packet from a buffer.
 *
 * @param ctrl_pkt Pointer to instance of @ref cs_router_control_packet, which should be loaded with
 * data
 * @param buffer Buffer with data that should be created into a control packet
 */
static void loadControlPacket(cs_router_control_packet *ctrl_pkt, uint8_t *buffer)
{
	int pkt_ctr = 0;

	ctrl_pkt->command_type = buffer[pkt_ctr++];
	ctrl_pkt->src_id = buffer[pkt_ctr++];
	ctrl_pkt->dest_id = buffer[pkt_ctr++];
	ctrl_pkt->request_id = sys_get_le16(buffer + pkt_ctr);
	pkt_ctr += 2;
	ctrl_pkt->length = sys_get_le16(buffer + pkt_ctr);
	pkt_ctr += 2;
	ctrl_pkt->payload = &buffer[pkt_ctr];
}

/**
 * @brief Handler for an incoming packet, from either CM4 or cloud.
 */
static void handleIncomingPacket(cs_packet_data *data, void *pkth)
{
	PacketHandler *ph_inst = static_cast<PacketHandler *>(pkth);
	cs_router_generic_packet generic_pkt;

	if (data->src_id == CS_INSTANCE_ID_UART_CM4) {
		cs_router_uart_packet uart_pkt;
		loadUartPacket(&uart_pkt, data->msg.buf);
		loadGenericPacket(&generic_pkt, uart_pkt.payload);
	} else {
		loadGenericPacket(&generic_pkt, data->msg.buf);
	}

	if (generic_pkt.type == CS_PACKET_TYPE_CONTROL) {
		cs_router_control_packet ctrl_pkt;
		loadControlPacket(&ctrl_pkt, generic_pkt.payload);

		cs_packet_data out;
		memset(&out, 0, sizeof(out));
		cs_packet_handler *outh =
			ph_inst->getHandler((cs_router_instance_id)ctrl_pkt.dest_id);
		// > 0 means we need to reply with a result
		outh->result.id = ctrl_pkt.request_id;
		outh->result.type = (cs_router_command_type)ctrl_pkt.command_type;
		outh->msg.buf_len = ctrl_pkt.length;
		memcpy(outh->msg.buf, ctrl_pkt.payload, ctrl_pkt.length);
		// dispatch data to peripheral
		k_work_submit(&outh->work_item);
	}
}

/**
 * @brief Handler for data coming from peripherals.
 */
static void handleOutgoingPacket(cs_packet_data *data, void *pkth)
{
	PacketHandler *ph_inst = static_cast<PacketHandler *>(pkth);
	uint8_t pkt_buf[CS_PACKET_BUF_SIZE];
	int pkt_len;
	cs_router_generic_packet_type pkt_type;

	// if a result id was set by the incoming packet handler,
	// create a result packet for request
	cs_packet_result *result = &ph_inst->getHandler(data->src_id)->result;
	if (result->id > 0) {
		pkt_len = wrapResultPacket(result->type, data->result_code, result->id,
					   data->msg.buf, data->msg.buf_len, pkt_buf);
		pkt_type = CS_PACKET_TYPE_RESULT;
		// request handled, reset the result id
		result->id = 0;
	} else {
		// all other data is wrapped as "data", the contents are unknown
		pkt_len = wrapDataPacket(data->src_id, data->msg.buf, data->msg.buf_len, pkt_buf);
		pkt_type = CS_PACKET_TYPE_DATA;
	}

	uint8_t tmp_buf[pkt_len];
	memcpy(tmp_buf, pkt_buf, pkt_len);

	int generic_pkt_len = wrapGenericPacket(pkt_type, tmp_buf, pkt_len, pkt_buf);
	pkt_len = generic_pkt_len;

	// when packet should be routed to CM4
	if (data->dest_id == CS_INSTANCE_ID_UART_CM4) {
		uint8_t generic_pkt_tmp_buf[generic_pkt_len];
		memcpy(generic_pkt_tmp_buf, pkt_buf, generic_pkt_len);

		pkt_len = wrapUartPacket(CS_PACKET_TYPE_GENERIC, generic_pkt_tmp_buf,
					 generic_pkt_len, pkt_buf);
	}

	cs_packet_handler *outh = ph_inst->getHandler(data->dest_id);
	outh->msg.buf_len = pkt_len;
	memcpy(outh->msg.buf, pkt_buf, pkt_len);
	// dispatch packet to the target
	k_work_submit(&outh->work_item);
}

/**
 * @brief Thread function that handles packet buffers from the message queue.
 *
 * @param inst Pointer to the class instance.
 * @param unused1 Unused parameter, is NULL.
 * @param unused2 Unused parameter, is NULL.
 */
static void handlePacketBuffers(void *inst, void *unused1, void *unused2)
{
	PacketHandler *pkth_inst = static_cast<PacketHandler *>(inst);
	cs_packet_data pkt_data;

	while (1) {
		// wait till message is retrieved from message queue
		if (k_msgq_get(&pkth_inst->_pkth_msgq, &pkt_data, K_FOREVER) == 0) {
			switch (pkt_data.type) {
			case CS_DATA_INCOMING:
				handleIncomingPacket(&pkt_data, pkth_inst);
				break;
			case CS_DATA_OUTGOING:
				handleOutgoingPacket(&pkt_data, pkth_inst);
				break;
			}
		} else {
			LOG_WRN("%s", "Failed to retrieve message from message queue");
		}
	}
}

/**
 * @brief Initialize PacketHandler instance.
 */
cs_ret_code_t PacketHandler::init()
{
	if (_initialized) {
		LOG_ERR("%s", "Already initialized");
		return CS_ERR_ALREADY_INITIALIZED;
	}

	k_mutex_init(&_pkth_mtx);
	// initialize message queue, aligned to 4-byte boundary
	k_msgq_init(&_pkth_msgq, _msgq_buf, sizeof(cs_packet_data), CS_PACKET_BUF_SIZE);

	// create thread for handling uart messages
	k_tid_t uart_thread = k_thread_create(
		&_pkth_tid, pkth_tid_stack_area, K_THREAD_STACK_SIZEOF(pkth_tid_stack_area),
		handlePacketBuffers, this, NULL, NULL, CS_PACKET_THREAD_PRIORITY, 0, K_NO_WAIT);

	_initialized = true;

	return CS_OK;
}

/**
 * @brief Register a handler that can be used for outgoing data.
 *
 * @param inst_id Instance ID of the destination instance that should handle the data.
 * @param inst Pointer to class instance according to destination ID.
 * @param cb Function pointer to function that should be called to transport the data.
 */
cs_ret_code_t PacketHandler::registerHandler(cs_router_instance_id inst_id, void *inst,
					     k_work_handler_t cb)
{
	if (!_initialized) {
		LOG_ERR("%s", "Not initialized");
		return CS_ERR_NOT_INITIALIZED;
	}

	k_mutex_lock(&_pkth_mtx, K_FOREVER);

	for (int i = 0; i < _handler_ctr; i++) {
		if (_handlers[i].id == inst_id) {
			LOG_ERR("Handler with ID %d already registered", inst_id);
			return CS_ERR_PACKET_HANDLER_ALREADY_REGISTERED;
		}
	}
	// create a new handler
	cs_packet_handler handler;
	memset(&handler, 0, sizeof(handler));
	handler.id = inst_id;
	handler.target_inst = inst;

	k_work_init(&handler.work_item, cb);

	// store handler
	memcpy(&_handlers[_handler_ctr++], &handler, sizeof(handler));

	k_mutex_unlock(&_pkth_mtx);

	return CS_OK;
}

/**
 * @brief Unregister a registered data handler.
 *
 * @param inst_id Instance ID that was registered for handling data.
 */
cs_ret_code_t PacketHandler::unregisterHandler(cs_router_instance_id inst_id)
{
	if (!_initialized) {
		LOG_ERR("%s", "Not initialized");
		return CS_ERR_NOT_INITIALIZED;
	}

	k_mutex_lock(&_pkth_mtx, K_FOREVER);

	for (int i = 0; i < _handler_ctr; i++) {
		if (_handlers[i].id == inst_id) {
			// clean from register by shifting next data to removed slot
			for (int j = (i - 1); i < (_handler_ctr - 1); i++) {
				_handlers[j] = _handlers[j + 1];
			}
			_handler_ctr--;
			return CS_OK;
		}
	}
	k_mutex_unlock(&_pkth_mtx);

	LOG_ERR("Could not find input handler for ID %d", inst_id);

	return CS_ERR_PACKET_HANDLER_NOT_FOUND;
}

/**
 * @brief Get an output handler by it's target ID. Used by the input handler
 * to pass data to peripherals.
 *
 * @param inst_id Instance ID of the destination instance that should handle the data.
 */
cs_packet_handler *PacketHandler::getHandler(cs_router_instance_id inst_id)
{
	if (!_initialized) {
		LOG_ERR("%s", "Not initialized");
		return NULL;
	}

	for (int i = 0; i < _handler_ctr; i++) {
		if (_handlers[i].id == inst_id) {
			return &_handlers[i];
		}
	}
	LOG_ERR("Could not find handler for ID %d", inst_id);
	return NULL;
}

/**
 * @brief Handle packet by calling the associated callback for an instance.
 *
 * @param data Structure with packet data. One of @ref cs_packet_data
 *
 * @return CS_OK if the packet was dispatched successfully.
 */
cs_ret_code_t PacketHandler::handlePacket(cs_packet_data *data)
{
	if (!_initialized) {
		LOG_ERR("%s", "Not initialized");
		return CS_ERR_NOT_INITIALIZED;
	}

	// check if the thread is still running
	if (k_thread_join(&_pkth_tid, K_NO_WAIT) == 0) {
		LOG_ERR("%s", "Packet handler thread is not running, exiting.");
		return CS_ERR_ABORTED;
	}

	// dispatch the packet data to be handled later (async)
	// don't wait till space becomes available, as it can cause deadlocks
	if (k_msgq_put(&_pkth_msgq, data, K_NO_WAIT) != 0) {
		LOG_WRN("%s", "Failed to submit message to packet handler queue, queue is full");
		return CS_ERR_PACKET_HANDLER_NOT_READY;
	};

	return CS_OK;
}
```

## src/cs_Router.cpp
```c
/**
 * Author: Ricardo Steijn
 * Copyright: Crownstone (https://crownstone.rocks)
 * Date: 18 Nov., 2022
 * License: Apache License 2.0
 */

#include "drivers/cs_Uart.h"
#include "drivers/cs_Wifi.h"
#include "drivers/ble/cs_BleCentral.h"
#include "socket/cs_WebSocket.h"
#include "cs_ReturnTypes.h"
#include "cs_PacketHandling.h"
#include "cs_RouterProtocol.h"

#include <zephyr/logging/log.h>
LOG_MODULE_REGISTER(cs_Router, LOG_LEVEL_INF);

#include <zephyr/device.h>

#define RS485_DEVICE DT_NODELABEL(uart2)

#define TEST_SSID "ssid"
#define TEST_PSK  "psk"

#define HOST_ADDR "addr"
#define HOST_PORT 14500

#define CROWNSTONE_UUID "24f000007d104805bfc17663a01c3bff"

int main(void)
{
	cs_ret_code_t ret = CS_OK;

	PacketHandler pkt_handler;
	ret |= pkt_handler.init();

	Wifi *wifi = Wifi::getInstance();
	if (wifi->init(TEST_SSID, TEST_PSK) == CS_OK) {
		int conn_ret = CS_OK;
		do {
			conn_ret = wifi->connect();
		} while (conn_ret == CS_ERR_WIFI_SCAN_RESULT_TIMEOUT);
	}

	// wait till wifi connection is established before creating websocket
	ret |= wifi->waitConnected(SYS_FOREVER_MS);

	WebSocket web_socket(CS_INSTANCE_ID_CLOUD, &pkt_handler);
	ret |= web_socket.init(HOST_ADDR, CS_SOCKET_IPV4, HOST_PORT);
	ret |= pkt_handler.registerHandler(CS_INSTANCE_ID_CLOUD, &web_socket,
					   WebSocket::sendMessage);
	ret |= web_socket.connect(NULL);

	BleCentral *ble = BleCentral::getInstance();
	ble->setSourceId(CS_INSTANCE_ID_BLE_CROWNSTONE_PERIPHERAL);
	ble->setDestinationId(CS_INSTANCE_ID_CLOUD);
	ret |= ble->init(CROWNSTONE_UUID, &pkt_handler);
	ret |= pkt_handler.registerHandler(CS_INSTANCE_ID_BLE_CROWNSTONE_PERIPHERAL, &ble,
					   BleCentral::sendBleMessage);

	const device *rs485_dev = DEVICE_DT_GET(RS485_DEVICE);
	Uart rs485(rs485_dev, CS_INSTANCE_ID_UART_RS485, CS_INSTANCE_ID_CLOUD, &pkt_handler);
	ret |= rs485.init(NULL);
	ret |= pkt_handler.registerHandler(CS_INSTANCE_ID_UART_RS485, &rs485,
					   Uart::sendUartMessage);

	if (ret) {
		LOG_ERR("Failed to initialize router (err %d)", ret);
		return EXIT_FAILURE;
	}

	LOG_INF("%s", "Crownstone router initialized");

	// wait till packet handler thread exits first,
	// then wait for other threads to terminate
	ret |= k_thread_join(&pkt_handler._pkth_tid, K_FOREVER);
	ret |= k_thread_join(&web_socket._ws_tid, K_FOREVER);
	ret |= k_thread_join(&rs485._uart_tid, K_FOREVER);
	if (ret) {
		return EXIT_FAILURE;
	}

	return EXIT_SUCCESS;
}
```

## src/cs_Socket.cpp
```c
/**
 * Author: Ricardo Steijn
 * Copyright: Crownstone (https://crownstone.rocks)
 * Date: 5 Dec., 2022
 * License: Apache License 2.0
 */

#include <zephyr/logging/log.h>
LOG_MODULE_REGISTER(cs_Socket, LOG_LEVEL_INF);

#include "cs_ReturnTypes.h"
#include "cs_Router.h"

#include <zephyr/net/net_ip.h>
#include <zephyr/net/socket.h>
#include <zephyr/net/tls_credentials.h>
#include <zephyr/net/http/client.h>
```

## src/cs_Util.cpp
```c
/**
 * Author: Ricardo Steijn
 * Copyright: Crownstone (https://crownstone.rocks)
 * Date: 22 Nov., 2022
 * License: Apache License 2.0
 */

#include <zephyr/logging/log.h>
LOG_MODULE_REGISTER(cs_Util, LOG_LEVEL_INF);

#include "cs_ReturnTypes.h"
#include "cs_Router.h"
```

## src/cs_WebSocket.cpp
```c
/**
 * Author: Ricardo Steijn
 * Copyright: Crownstone (https://crownstone.rocks)
 * Date: 5 Dec., 2022
 * License: Apache License 2.0
 */

#include <string.h>

#include <zephyr/logging/log.h>
LOG_MODULE_REGISTER(cs_Socket, LOG_LEVEL_INF);

#include "cs_ReturnTypes.h"
#include "cs_Router.h"
#include "socket/cs_WebSocket.h"

#include <zephyr/net/net_ip.h>
#include <zephyr/net/socket.h>

#include <zephyr/net/tls_credentials.h>
#include "socket/cs_CaCertificate.h"

/**
 * @brief Initialize websocket.
 *
 * @param opts Instance of @ref cs_socket_opts. port and one of host_url
 * or peer_addr should be provided. hostname is required for TLS and peer_addr.
 *
 * @return CS_OK if the initialization is successful.
 */
cs_err_t WebSocket::init(struct cs_socket_opts *opts)
{
	if (_is_initialized) {
		LOG_ERR("Already initialized");
		return CS_ERR_ALREADY_INITIALIZED;
	}

	// register CA certificate when TLS should be used
	if (IS_ENABLED(CONFIG_NET_SOCKETS_SOCKOPT_TLS)) {
		if (tls_credential_add(CA_CERTIFICATE_TAG, TLS_CREDENTIAL_CA_CERTIFICATE,
				       ca_certificate, sizeof(ca_certificate)) < 0) {
			LOG_ERR("Failed to register public certificate: %d", err);
			return CS_ERR_SOCKET_CA_CERT_REGISTER_FAILED;
		}
	}

	if (opts->host_mode == CS_SOCKET_HOST_DOMAIN) {
		static struct zsock_addrinfo hints;
		hints.ai_family = opts->use_ipv6 ? AF_INET6 : AF_INET;
		hints.ai_socktype = SOCK_STREAM;
		hints.ai_protocol = IPPROTO_TCP;

		// 2 byte integer to string
		char port_str[3]; // uint16 + terminator
		snprintk(port_str, sizeof(port_str), "%s", opts->domain.port);

		// resolve host using DNS
		struct zsock_addrinfo *res;
		if (zsock_getaddrinfo(opts->domain.domain_name, port_str, &hints, &res) != 0) {
			LOG_ERR("Unable to resolve host address");
			return CS_ERR_SOCKET_UNABLE_TO_RESOLVE_HOST;
		}
		_addr = res->ai_addr;
		_addr_len = res->ai_addrlen;
		_host_name = opts->domain.domain_name;

		// create socket, using TLS when specified
		if (IS_ENABLED(CONFIG_NET_SOCKETS_SOCKOPT_TLS)) {
			_sock_nr = zsock_socket(res->ai_family, res->ai_socktype, IPPROTO_TLS_1_2);
		} else {
			_sock_nr = zsock_socket(res->ai_family, res->ai_socktype, res->ai_protocol);
		}
	} else if (opts->host_mode == CS_SOCKET_HOST_ADDR) {
		if (opts->use_ipv6) {
			struct sockaddr_in6 addr6;
			addr6.sin6_family = AF_INET6;
			addr6.sin6_port = htons(opts->addr.port);
			// convert ascii addr to internal representation
			zsock_inet_pton(AF_INET6, opts->addr.peer_addr, &addr6.sin6_addr);
			_addr = (struct sockaddr *)&addr6;
			_addr_len = sizeof(addr6);
		} else {
			struct sockaddr_in addr4;
			addr4.sin_family = AF_INET;
			addr4.sin_port = htons(opts->addr.port);
			// convert ascii addr to internal representation
			zsock_inet_pton(AF_INET, opts->addr.peer_addr, &addr4.sin_addr);
			_addr = (struct sockaddr *)&addr4;
			_addr_len = sizeof(addr4);
		}
		_host_name = opts->addr.host_name;

		// create socket, using TLS when specified
		if (IS_ENABLED(CONFIG_NET_SOCKETS_SOCKOPT_TLS)) {
			_sock_nr = zsock_socket(_addr->sa_family, SOCK_STREAM, IPPROTO_TLS_1_2);

		} else {
			_sock_nr = zsock_socket(_addr->sa_family, SOCK_STREAM, IPPROTO_TCP);
		}
	} else {
		LOG_ERR("Invalid mode provided");
		return CS_ERR_SOCKET_INVALID_MODE;
	}

	if (_sock_nr < 0) {
		LOG_ERR("Failed to create socket");
		return CS_ERR_SOCKET_CREATION_FAILED;
	}

	if (IS_ENABLED(CONFIG_NET_SOCKETS_SOCKOPT_TLS)) {
		if (zsock_setsockopt(_sock_nr, SOL_TLS, TLS_HOSTNAME, _host_name,
				     strlen(_host_name)) < 0) {
			LOG_ERR("Failed to set TLS hostname");
			return CS_ERR_SOCKET_SET_TLS_HOSTNAME_FAILED;
		}

		sec_tag_t sec_tag_opt[] = {
			CA_CERTIFICATE_TAG,
		};
		// set TLS tags, in this case only certificate
		if (zsock_setsockopt(_sock_nr, SOL_TLS, TLS_SEC_TAG_LIST, sec_tag_opt,
				     sizeof(sec_tag_opt)) < 0) {
			LOG_ERR("Failed to set TLS_SEC_TAG_LIST option");
			return CS_ERR_SOCKET_SET_TLS_TAG_LIST_FAILED;
		}
	}

	return CS_OK;
}

/**
 * @brief Connect the socket to the network.
 *
 * @return CS_OK if connection is successful.
 */
cs_err_t WebSocket::connect()
{
	if (!_is_initialized) {
		LOG_ERR("Not initialized");
		return CS_ERR_NOT_INITIALIZED;
	}

	if (zsock_connect(_sock_nr, _addr, _addr_len) < 0) {
		return CS_FAIL;
	}

	return CS_OK;
}

/**
 * @brief Close socket.
 */
cs_err_t WebSocket::close()
{
	if (!_is_initialized || _sock_nr < 0) {
		LOG_ERR("Not initialized");
		return CS_ERR_NOT_INITIALIZED;
	}

	if (zsock_close(_sock_nr) < 0) {
		LOG_ERR("Failed to close socket");
		return CS_ERR_SOCKET_CLOSE_FAILED;
	}

	return CS_OK;
}

/**
 * @brief Send a HTTP GET request over the socket.
 *
 * @param endpoint Endpoint / url for the request
 *
 * @return CS_OK if the request was done succesfully.
 */
cs_err_t WebSocket::sendHttpGetRequest(const char *endpoint)
{
	struct http_request get_req = {0};

	get_req.method = HTTP_GET;
	get_req.url = strcat("/", endpoint);
	get_req.host = _host_name;
	get_req.protocol = HTTP_PROTOCOL_VER;
	get_req.recv_buf = _socket_recv_buf;
	get_req.recv_buf_len = CS_SOCKET_RECV_BUFFER_SIZE;

	if (http_client_req(_sock_nr, &get_req, CS_SOCKET_RECV_TIMEOUT, this) < 0) {
		LOG_ERR("Failed to send http GET request");
		return CS_ERR_SOCKET_HTTP_GET_FAILED;
	}

	return CS_OK;
}

/**
 * @brief Send a HTTP POST request over the socket.
 * 
 * @param endpoint Endpoint / url of the request
 * @param payload Payload that should be send to the server
*/
cs_err_t WebSocket::sendHttpPostRequest(const char *endpoint, const char *payload)
{
	struct http_request post_req = {0};

	post_req.method = HTTP_POST;
	post_req.url = strcat("/", endpoint);
	post_req.host = _host_name;
	post_req.protocol = HTTP_PROTOCOL_VER;
	post_req.payload = payload;
	post_req.payload_len = strlen(payload);
	post_req.recv_buf = _socket_recv_buf;
	post_req.recv_buf_len = CS_SOCKET_RECV_BUFFER_SIZE;

	if (http_client_req(_sock_nr, &post_req, CS_SOCKET_RECV_TIMEOUT, this) < 0) {
		LOG_ERR("Failed to send http POST request");
		return CS_ERR_SOCKET_HTTP_GET_FAILED;
	}

	return CS_OK;
}
```
